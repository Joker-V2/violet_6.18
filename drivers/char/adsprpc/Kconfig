## drivers/char/adsprpc/Kconfig
```kconfig
# SPDX-License-Identifier: GPL-2.0-only

config MSM_ADSPRPC
	bool "Qualcomm FastRPC driver"
	depends on ARCH_QCOM && RPMSG && QCOM_SCM && NET
	select QCOM_PDR_HELPERS
	help
	  Provides the /dev/adsprpc-smd and /dev/cdsprpc-smd interfaces that
	  the vendor FastRPC user library uses to call into the ADSP and the
	  CDSP.
```

## drivers/dma-buf/heaps/Kconfig
```kconfig
config DMABUF_HEAPS_SYSTEM
	tristate "DMA-BUF System Heap"
	depends on DMABUF_HEAPS
	help
	  Choose this option to enable the system dmabuf heap. The system heap
	  is backed by pages from the buddy allocator. If in doubt, say Y.

config DMABUF_HEAPS_CMA
	tristate "DMA-BUF CMA Heap"
	depends on DMABUF_HEAPS && DMA_CMA
	help
	  Choose this option to enable dma-buf CMA heap. This heap is backed
	  by the Contiguous Memory Allocator (CMA). If your system has these
	  regions, you should say Y here.

config DMABUF_HEAPS_CMA_LEGACY
	bool "Legacy DMA-BUF CMA Heap"
	default y
	depends on DMABUF_HEAPS_CMA
	help
	  Add a duplicate CMA-backed dma-buf heap with legacy naming derived
	  from the CMA area's devicetree node, or "reserved" if the area is not
	  defined in the devicetree. This uses the same underlying allocator as
	  CONFIG_DMABUF_HEAPS_CMA.

config DMABUF_HEAPS_MSM_LEGACY_ION
	bool "Legacy /dev/ion for msm-4.14/4.19 vendor userspace"
	depends on DMABUF_HEAPS_SYSTEM=y && DMA_CMA
	select GENERIC_ALLOCATOR
	help
	  Provide /dev/ion with the ION API of Linux 4.12-5.x and the msm heap
	  IDs of msm-4.14/4.19, backed by DMA-BUF: the system heap and the
	  contiguous heaps the "qcom,msm-ion" DT node describes. Needed by
	  vendor userspace built against those kernels, such as
	  libQSEEComAPI. If unsure, say N.
```

## drivers/platform/msm/Kconfig
```kconfig
# SPDX-License-Identifier: GPL-2.0-only

menu "Qualcomm Technologies, Inc. MSM specific device drivers"
	depends on ARCH_QCOM

config QPNP_REVID
	tristate "QPNP Revision ID Peripheral"
	depends on SPMI
	help
	  Say 'y' here to include support for the Qualcomm Technologies, Inc.
	  QPNP REVID peripheral. REVID prints out the PMIC type and revision
	  numbers in the kernel log along with the PMIC option status. The PMIC
	  type is mapped to a QTI chip part number and logged as well.

endmenu
```

## drivers/power/supply/qcom/Kconfig
```kconfig
# SPDX-License-Identifier: GPL-2.0-only
menuconfig QCOM_POWER_SUPPLY
	bool "Support for Qualcomm Technologies, Inc. power supply"
	depends on ARCH_QCOM

if QCOM_POWER_SUPPLY

config QPNP_QG
	tristate "QPNP Qgauge driver"
	depends on MFD_SPMI_PMIC
	depends on IIO
	help
	  Say Y here to enable the Qualcomm Technologies, Inc. QGauge driver
	  which uses the periodic sampling of the battery voltage and current
	  to determine the battery state-of-charge (SOC) and supports other
	  battery management features.

	  To compile this driver as a module, choose M here: the
	  module will be called qcom-qpnp-qg.

endif
```

## techpack/display/Kconfig
```kconfig
# SPDX-License-Identifier: GPL-2.0-only

config QTI_DISPLAY_SM6150
	bool "Qualcomm SDE display driver for SM6150"
	depends on DRM=y && ARCH_QCOM && OF && MMU
	depends on !DRM_MSM
	select DRM_KMS_HELPER
	select DRM_DISPLAY_HELPER
	select DRM_MIPI_DSI
	select DRM_PANEL
	select BACKLIGHT_CLASS_DEVICE
	select SYNC_FILE
	select QCOM_UBWC_CONFIG
	help
	  The SDE display driver of Qualcomm's display-drivers, built into
	  the kernel for SM6150 with its target config: the SDE and DSI,
	  without DisplayPort, writeback and the RSC. It provides the msm_drm
	  interface the vendor display HALs use.

	  It takes the place of the drm/msm driver, which cannot be built
	  along with it.
```
